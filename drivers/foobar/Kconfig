## drivers/foobar/Kconfig
```kconfig
menuconfig FOOBARDEVICES
	depends on FOOBAR
	bool "Foobar device support"
	---help---
	  Foobar device driver support
	  If unsure, say Y.

if FOOBARDEVICES

config FOOBAR_DUMMY
	tristate "Dummy foobar driver support"
	---help---
	  Foobar dummy device driver.
	  To compile this driver as a module, choose M here: the module
	  will be called dummy.

endif # FOOBARDEVICES
```

## foobar/Kconfig
```kconfig
#
# Foobar config
#

menuconfig FOOBAR
	bool "Foobar support"
	---help---
	  Toy subsystem for working with kernel static analysis
```

## virt/lcd/Kconfig
```kconfig
#
# LCD configuration
#

config LCD
	tristate "Light-weight Capability Domains"
	depends on X86_64
	select HAVE_LCD
	default y
	---help---
	Light-weight Capability Domains.

config HAVE_LCD
	bool
```
